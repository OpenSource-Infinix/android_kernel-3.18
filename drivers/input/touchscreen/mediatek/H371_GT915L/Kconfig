## drivers/input/touchscreen/mediatek/H371_GT915L/Kconfig
```kconfig
#
# Touchscreen driver configuration
#
if TOUCHSCREEN_MTK_H371_GT915L

config H371_GT915L_FIRMWARE
	string "GT9XX for Mediatek firmware"

config H371_GT915L_CONFIG
	string "GT9XX for Mediatek config"

config GTP_DRIVER_SEND_CFG
	bool "GTP_DRIVER_SEND_CFG"
	default n
	help
	  Say Y here if you have GT9XX touch panel GTP_DRIVER_SEND_CFG.

	  If unsure, say N.

	  To compile this dirver as a module, choose M here: the
	  module will be called.

config GTP_CUSTOM_CFG
	bool "GTP_CUSTOM_CFG"
	default n
	help
	  Say Y here if you have GT9XX touch panel GTP_CUSTOM_CFG.

	  If unsure, say N.

	  To compile this dirver as a module, choose M here: the
	  module will be called.

config GTP_CHANGE_X2Y
	bool "GTP_CHANGE_X2Y"
	default n
	help
	  Say Y here if you have GT9XX touch panel GTP_CHANGE_X2Y.

	  If unsure, say N.

	  To compile this dirver as a module, choose M here: the
	  module will be called.

config GTP_WARP_X_ON
	bool "GTP_WARP_X_ON"
	default n
	help
	  Say Y here if you have GT9XX touch panel GTP_WARP_X_ON.

	  If unsure, say N.

	  To compile this dirver as a module, choose M here: the
	  module will be called.

config GTP_WARP_Y_ON
	bool "GTP_WARP_Y_ON"
	default n
	help
	  Say Y here if you have GT9XX touch panel GTP_WARP_Y_ON.

	  If unsure, say N.

	  To compile this dirver as a module, choose M here: the
	  module will be called.


config GTP_HOTKNOT
	bool "GTP_HOTKNOT"
	default n
	help
	  Say Y here if you have GT9XX touch panel GTP_HOTKNOT.

	  If unsure, say N.

	  To compile this dirver as a module, choose M here: the
	  module will be called.

config HOTKNOT_TYPE
	bool "HOTKNOT_TYPE"
	default n
	help
	  Say Y here if you have GT9XX touch panel HOTKNOT_TYPE.

	  If unsure, say N.

	  To compile this dirver as a module, choose M here: the
	  module will be called.

config HOTKNOT_BLOCK_RW
	bool "HOTKNOT_BLOCK_RW"
	default n
	help
	  Say Y here if you have GT9XX touch panel HOTKNOT_BLOCK_RW.

	  If unsure, say N.

	  To compile this dirver as a module, choose M here: the
	  module will be called.

config GTP_PROXIMITY
	bool "GTP_PROXIMITY"
	default n
	help
	  Say Y here if you have GT9XX touch panel GTP_PROXIMITY.

	  If unsure, say N.

	  To compile this dirver as a module, choose M here: the
	  module will be called.

config GTP_WITH_STYLUS
	bool "GTP_WITH_STYLUS"
	default n
	help
	  Say Y here if you have GT9XX touch panel GTP_WITH_STYLUS.

	  If unsure, say N.

	  To compile this dirver as a module, choose M here: the
	  module will be called.

config GTP_HAVE_STYLUS_KEY
	bool "GTP_HAVE_STYLUS_KEY"
	default n
	help
	  Say Y here if you have GT9XX touch panel GTP_HAVE_STYLUS_KEY.

	  If unsure, say N.

	  To compile this dirver as a module, choose M here: the
	  module will be called.

config GTP_AUTO_UPDATE
	bool "GTP_AUTO_UPDATE"
	default n
	help
	  Say Y here if you have GT9XX touch panel GTP_AUTO_UPDATE.

	  If unsure, say N.

	  To compile this dirver as a module, choose M here: the
	  module will be called.

config GTP_HEADER_FW_UPDATE
	bool "GTP_HEADER_FW_UPDATE"
	default n
	help
	  Say Y here if you have GT9XX touch panel GTP_HEADER_FW_UPDATE.

	  If unsure, say N.

	  To compile this dirver as a module, choose M here: the
	  module will be called.

config GTP_AUTO_UPDATE_CFG
	bool "GTP_AUTO_UPDATE_CFG"
	default n
	help
	  Say Y here if you have GT9XX touch panel GTP_AUTO_UPDATE_CFG.

	  If unsure, say N.

	  To compile this dirver as a module, choose M here: the
	  module will be called.

config GTP_CREATE_WR_NODE
	bool "GTP_CREATE_WR_NODE"
	default n
	help
	  Say Y here if you have GT9XX touch panel GTP_CREATE_WR_NODE.

	  If unsure, say N.

	  To compile this dirver as a module, choose M here: the
	  module will be called.

config GTP_ESD_PROTECT
	bool "GTP_ESD_PROTECT"
	default n
	help
	  Say Y here if you have GT9XX touch panel GTP_ESD_PROTECT.

	  If unsure, say N.

	  To compile this dirver as a module, choose M here: the
	  module will be called.

config GTP_CHARGER_SWITCH
	bool "GTP_CHARGER_SWITCH"
	default n
	help
	  Say Y here if you have GT9XX touch panel GTP_CHARGER_SWITCH.

	  If unsure, say N.

	  To compile this dirver as a module, choose M here: the
	  module will be called.

config GTP_DEBUG_ARRAY_ON
	bool "GTP_DEBUG_ARRAY_ON"
	default n
	help
	  Say Y here if you have GT9XX touch panel GTP_DEBUG_ARRAY_ON.

	  If unsure, say N.

	  To compile this dirver as a module, choose M here: the
	  module will be called.

config GTP_DEBUG_FUNC_ON
	bool "GTP_DEBUG_FUNC_ON"
	default n
	help
	  Say Y here if you have GT9XX touch panel GTP_DEBUG_FUNC_ON.

	  If unsure, say N.

	  To compile this dirver as a module, choose M here: the
	  module will be called.

config GTP_POWER_CTRL_SLEEP
	bool "GTP_POWER_CTRL_SLEEP"
	default n
	help
	  Say Y here if you have GT9XX touch panel GTP_POWER_CTRL_SLEEP.

	  If unsure, say N.

	  To compile this dirver as a module, choose M here: the
	  module will be called.
endif
```
